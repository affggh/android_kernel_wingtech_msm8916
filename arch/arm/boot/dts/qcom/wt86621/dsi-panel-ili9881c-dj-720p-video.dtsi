/* Copyright (c) 2016, The Linux Foundation. All rights reserved.
 *
 * This program is free software; you can redistribute it and/or modify
 * it under the terms of the GNU General Public License version 2 and
 * only version 2 as published by the Free Software Foundation.
 *
 * This program is distributed in the hope that it will be useful,
 * but WITHOUT ANY WARRANTY; without even the implied warranty of
 * MERCHANTABILITY or FITNESS FOR A PARTICULAR PURPOSE.  See the
 * GNU General Public License for more details.
 */

&mdss_mdp {
			dsi_ili9881c_dj_720p_video: qcom,mdss_dsi_ili9881c_dj_720p_video {
				qcom,mdss-dsi-panel-name = "ili9881c_HD720p_video_DJ";
				qcom,mdss-dsi-panel-controller = <&mdss_dsi0>;
				qcom,mdss-dsi-panel-type = "dsi_video_mode";
				qcom,mdss-dsi-panel-destination = "display_1";
				qcom,mdss-dsi-panel-framerate = <0x3c>;
				qcom,mdss-dsi-virtual-channel-id = <0x00>;
				qcom,mdss-dsi-stream = <0x00>;
				qcom,mdss-dsi-panel-width = <0x2d0>;
				qcom,mdss-dsi-panel-height = <0x500>;
				qcom,mdss-pan-physical-width-dimension = <0x3e>;
				qcom,mdss-pan-physical-height-dimension = <0x6e>;
				qcom,mdss-dsi-h-front-porch = <0x6e>;
				qcom,mdss-dsi-h-back-porch = <0xb4>;
				qcom,mdss-dsi-h-pulse-width = <0x08>;
				qcom,mdss-dsi-h-sync-skew = <0x00>;
				qcom,mdss-dsi-v-back-porch = <0x12>;
				qcom,mdss-dsi-v-front-porch = <0x0a>;
				qcom,mdss-dsi-v-pulse-width = <0x04>;
				qcom,mdss-dsi-h-left-border = <0x00>;
				qcom,mdss-dsi-h-right-border = <0x00>;
				qcom,mdss-dsi-v-top-border = <0x00>;
				qcom,mdss-dsi-v-bottom-border = <0x00>;
				qcom,mdss-dsi-bpp = <0x18>;
				qcom,mdss-dsi-underflow-color = <0xff>;
				qcom,mdss-dsi-border-color = <0x00>;
				qcom,mdss-dsi-on-command = <0x39010000 0x4ff 0x98810339 0x1000000 0x20100 0x39010000 0x202 0x390100 0x02 0x3723901 0x00 0x2040039 0x1000000 0x20500 0x39010000 0x206 0x9390100 0x02 0x7003901 0x00 0x2080039 0x1000000 0x20901 0x39010000 0x20a 0x390100 0x02 0xb003901 0x00 0x20c0139 0x1000000 0x20d00 0x39010000 0x20e 0x390100 0x02 0xf143901 0x00 0x2101439 0x1000000 0x21100 0x39010000 0x212 0x390100 0x02 0x13003901 0x00 0x2140039 0x1000000 0x21500 0x39010000 0x216 0x390100 0x02 0x17003901 0x00 0x2180039 0x1000000 0x21900 0x39010000 0x21a 0x390100 0x02 0x1b003901 0x00 0x21c0039 0x1000000 0x21d00 0x39010000 0x21e 0x40390100 0x02 0x1f803901 0x00 0x2200539 0x1000000 0x22102 0x39010000 0x222 0x390100 0x02 0x23003901 0x00 0x2240039 0x1000000 0x22500 0x39010000 0x226 0x390100 0x02 0x27003901 0x00 0x2283339 0x1000000 0x22902 0x39010000 0x22a 0x390100 0x02 0x2b003901 0x00 0x22c0039 0x1000000 0x22d00 0x39010000 0x22e 0x390100 0x02 0x2f003901 0x00 0x2300039 0x1000000 0x23100 0x39010000 0x232 0x390100 0x02 0x33003901 0x00 0x2340439 0x1000000 0x23500 0x39010000 0x236 0x390100 0x02 0x37003901 0x00 0x2387839 0x1000000 0x23900 0x39010000 0x23a 0x40390100 0x02 0x3b403901 0x00 0x23c0039 0x1000000 0x23d00 0x39010000 0x23e 0x390100 0x02 0x3f003901 0x00 0x2400039 0x1000000 0x24100 0x39010000 0x242 0x390100 0x02 0x43003901 0x00 0x2440039 0x1000000 0x25001 0x39010000 0x251 0x23390100 0x02 0x52453901 0x00 0x2536739 0x1000000 0x25489 0x39010000 0x255 0xab390100 0x02 0x56013901 0x00 0x2572339 0x1000000 0x25845 0x39010000 0x259 0x67390100 0x02 0x5a893901 0x00 0x25bab39 0x1000000 0x25ccd 0x39010000 0x25d 0xef390100 0x02 0x5e113901 0x00 0x25f0139 0x1000000 0x26000 0x39010000 0x261 0x15390100 0x02 0x62143901 0x00 0x2630e39 0x1000000 0x2640f 0x39010000 0x265 0xc390100 0x02 0x660d3901 0x00 0x2670639 0x1000000 0x26802 0x39010000 0x269 0x7390100 0x02 0x6a023901 0x00 0x26b0239 0x1000000 0x26c02 0x39010000 0x26d 0x2390100 0x02 0x6e023901 0x00 0x26f0239 0x1000000 0x27002 0x39010000 0x271 0x2390100 0x02 0x72023901 0x00 0x2730239 0x1000000 0x27402 0x39010000 0x275 0x1390100 0x02 0x76003901 0x00 0x2771439 0x1000000 0x27815 0x39010000 0x279 0xe390100 0x02 0x7a0f3901 0x00 0x27b0c39 0x1000000 0x27c0d 0x39010000 0x27d 0x6390100 0x02 0x7e023901 0x00 0x27f0739 0x1000000 0x28002 0x39010000 0x281 0x2390100 0x02 0x82023901 0x00 0x2830239 0x1000000 0x28402 0x39010000 0x285 0x2390100 0x02 0x86023901 0x00 0x2870239 0x1000000 0x28802 0x39010000 0x289 0x2390100 0x02 0x8a023901 0x00 0x4ff9881 0x4390100 0x02 0x3901 0x00 0x26c1539 0x1000000 0x26e2a 0x39010000 0x26f 0x33390100 0x02 0x3a943901 0x00 0x28d1a39 0x1000000 0x287ba 0x39010000 0x226 0x76390100 0x02 0xb2d13901 0x00 0x2b50639 0x1000000 0x2170c 0x39010000 0x4ff 0x98810139 0x1000000 0x2220a 0x39010000 0x231 0x390100 0x02 0x538c3901 0x00 0x2558f39 0x1000000 0x250c0 0x39010000 0x251 0xc0390100 0x02 0x60083901 0x00 0x2a00839 0x1000000 0x2a119 0x39010000 0x2a2 0x26390100 0x02 0xa31a3901 0x00 0x2a41d39 0x1000000 0x2a52c 0x39010000 0x2a6 0x21390100 0x02 0xa7223901 0x00 0x2a87c39 0x1000000 0x2a921 0x39010000 0x2aa 0x2e390100 0x02 0xab663901 0x00 0x2ac1c39 0x1000000 0x2ad18 0x39010000 0x2ae 0x4e390100 0x02 0xaf1a3901 0x00 0x2b02239 0x1000000 0x2b149 0x39010000 0x2b2 0x56390100 0x02 0xb3393901 0x00 0x2c00839 0x1000000 0x2c11a 0x39010000 0x2c2 0x26390100 0x02 0xc30b3901 0x00 0x2c40e39 0x1000000 0x2c524 0x39010000 0x2c6 0x18390100 0x02 0xc71b3901 0x00 0x2c88539 0x1000000 0x2c917 0x39010000 0x2ca 0x23390100 0x02 0xcb793901 0x00 0x2cc1c39 0x1000000 0x2cd1f 0x39010000 0x2ce 0x50390100 0x02 0xcf2d3901 0x00 0x2d03139 0x1000000 0x2d149 0x39010000 0x2d2 0x57390100 0x02 0xd3393901 0x00 0x4ff9881 0x390100 0x02 0x35003901 0x7800 0x2110039 0x100000a 0x22900>;
				qcom,mdss-dsi-off-command = [05 01 00 00 1f 00 02 28 00 05 01 00 00 8c 00 02 10 00];
				qcom,mdss-dsi-on-command-state = "dsi_lp_mode";
				qcom,mdss-dsi-off-command-state = "dsi_hs_mode";
				qcom,mdss-dsi-h-sync-pulse = <0x01>;
				qcom,mdss-dsi-traffic-mode = "burst_mode";
				qcom,mdss-dsi-bllp-eof-power-mode;
				qcom,mdss-dsi-bllp-power-mode;
				qcom,mdss-dsi-lane-0-state;
				qcom,mdss-dsi-lane-1-state;
				qcom,mdss-dsi-lane-2-state;
				qcom,mdss-dsi-panel-timings = <0xad281a00 0x52542090 0x21030400>;
				qcom,mdss-dsi-t-clk-post = <0x03>;
				qcom,mdss-dsi-t-clk-pre = <0x22>;
				qcom,mdss-dsi-bl-min-level = <0x01>;
				qcom,mdss-dsi-bl-max-level = <0xff>;
				qcom,mdss-dsi-bl-pmic-pwm-frequency = <0x64>;
				qcom,mdss-dsi-bl-pmic-bank-select = <0x00>;
				qcom,mdss-dsi-dma-trigger = "trigger_sw";
				qcom,mdss-dsi-mdp-trigger = "none";
				qcom,mdss-dsi-bl-pmic-control-type = "bl_ctrl_pwm";
				qcom,mdss-dsi-lp11-init;
				qcom,mdss-dsi-init-delay-us = <0xc350>;
				qcom,mdss-dsi-reset-sequence = <0x01 0x05 0x00 0x0a 0x01 0x50>;
			};
};