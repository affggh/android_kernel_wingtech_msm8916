/* Copyright (c) 2016, The Linux Foundation. All rights reserved.
 *
 * This program is free software; you can redistribute it and/or modify
 * it under the terms of the GNU General Public License version 2 and
 * only version 2 as published by the Free Software Foundation.
 *
 * This program is distributed in the hope that it will be useful,
 * but WITHOUT ANY WARRANTY; without even the implied warranty of
 * MERCHANTABILITY or FITNESS FOR A PARTICULAR PURPOSE.  See the
 * GNU General Public License for more details.
 */

&mdss_mdp {
			dsi_ili9881c_dj_boe_720p_video: qcom,mdss_dsi_ili9881c_dj_boe_720p_video {
				qcom,mdss-dsi-panel-name = "ili9881c_boe_HD720p_video_DJ";
				qcom,mdss-dsi-panel-controller = <&mdss_dsi0>;
				qcom,mdss-dsi-panel-type = "dsi_video_mode";
				qcom,mdss-dsi-panel-destination = "display_1";
				qcom,mdss-dsi-panel-framerate = <0x3c>;
				qcom,mdss-dsi-virtual-channel-id = <0x00>;
				qcom,mdss-dsi-stream = <0x00>;
				qcom,mdss-dsi-panel-width = <0x2d0>;
				qcom,mdss-dsi-panel-height = <0x500>;
				qcom,mdss-pan-physical-width-dimension = <0x3e>;
				qcom,mdss-pan-physical-height-dimension = <0x6e>;
				qcom,mdss-dsi-h-front-porch = <0x6e>;
				qcom,mdss-dsi-h-back-porch = <0xb4>;
				qcom,mdss-dsi-h-pulse-width = <0x08>;
				qcom,mdss-dsi-h-sync-skew = <0x00>;
				qcom,mdss-dsi-v-back-porch = <0x12>;
				qcom,mdss-dsi-v-front-porch = <0x0a>;
				qcom,mdss-dsi-v-pulse-width = <0x04>;
				qcom,mdss-dsi-h-left-border = <0x00>;
				qcom,mdss-dsi-h-right-border = <0x00>;
				qcom,mdss-dsi-v-top-border = <0x00>;
				qcom,mdss-dsi-v-bottom-border = <0x00>;
				qcom,mdss-dsi-bpp = <0x18>;
				qcom,mdss-dsi-underflow-color = <0xff>;
				qcom,mdss-dsi-border-color = <0x00>;
				qcom,mdss-dsi-on-command = [39 01 00 00 00 00 04 ff 98 81 03 39 01 00 00 00 00 02 01 00 39 01 00 00 00 00 02 02 00 39 01 00 00 00 00 02 03 73 39 01 00 00 00 00 02 04 00 39 01 00 00 00 00 02 05 00 39 01 00 00 00 00 02 06 0c 39 01 00 00 00 00 02 07 00 39 01 00 00 00 00 02 08 00 39 01 00 00 00 00 02 09 19 39 01 00 00 00 00 02 0a 01 39 01 00 00 00 00 02 0b 01 39 01 00 00 00 00 02 0c 0b 39 01 00 00 00 00 02 0d 01 39 01 00 00 00 00 02 0e 01 39 01 00 00 00 00 02 0f 26 39 01 00 00 00 00 02 10 26 39 01 00 00 00 00 02 11 00 39 01 00 00 00 00 02 12 00 39 01 00 00 00 00 02 13 02 39 01 00 00 00 00 02 14 00 39 01 00 00 00 00 02 15 00 39 01 00 00 00 00 02 16 00 39 01 00 00 00 00 02 17 00 39 01 00 00 00 00 02 18 00 39 01 00 00 00 00 02 19 00 39 01 00 00 00 00 02 1a 00 39 01 00 00 00 00 02 1b 00 39 01 00 00 00 00 02 1c 00 39 01 00 00 00 00 02 1d 00 39 01 00 00 00 00 02 1e 44 39 01 00 00 00 00 02 1f c0 39 01 00 00 00 00 02 20 0a 39 01 00 00 00 00 02 21 03 39 01 00 00 00 00 02 22 0a 39 01 00 00 00 00 02 23 00 39 01 00 00 00 00 02 24 8c 39 01 00 00 00 00 02 25 8c 39 01 00 00 00 00 02 26 00 39 01 00 00 00 00 02 27 00 39 01 00 00 00 00 02 28 3b 39 01 00 00 00 00 02 29 03 39 01 00 00 00 00 02 2a 00 39 01 00 00 00 00 02 2b 00 39 01 00 00 00 00 02 2c 00 39 01 00 00 00 00 02 2d 00 39 01 00 00 00 00 02 2e 00 39 01 00 00 00 00 02 2f 00 39 01 00 00 00 00 02 30 00 39 01 00 00 00 00 02 31 00 39 01 00 00 00 00 02 32 00 39 01 00 00 00 00 02 33 00 39 01 00 00 00 00 02 34 00 39 01 00 00 00 00 02 35 00 39 01 00 00 00 00 02 36 00 39 01 00 00 00 00 02 37 00 39 01 00 00 00 00 02 38 00 39 01 00 00 00 00 02 39 00 39 01 00 00 00 00 02 3a 00 39 01 00 00 00 00 02 3b 00 39 01 00 00 00 00 02 3c 00 39 01 00 00 00 00 02 3d 00 39 01 00 00 00 00 02 3e 00 39 01 00 00 00 00 02 3f 00 39 01 00 00 00 00 02 40 00 39 01 00 00 00 00 02 41 00 39 01 00 00 00 00 02 42 00 39 01 00 00 00 00 02 43 00 39 01 00 00 00 00 02 44 00 39 01 00 00 00 00 02 50 01 39 01 00 00 00 00 02 51 23 39 01 00 00 00 00 02 52 45 39 01 00 00 00 00 02 53 67 39 01 00 00 00 00 02 54 89 39 01 00 00 00 00 02 55 ab 39 01 00 00 00 00 02 56 01 39 01 00 00 00 00 02 57 23 39 01 00 00 00 00 02 58 45 39 01 00 00 00 00 02 59 67 39 01 00 00 00 00 02 5a 89 39 01 00 00 00 00 02 5b ab 39 01 00 00 00 00 02 5c cd 39 01 00 00 00 00 02 5d ef 39 01 00 00 00 00 02 5e 11 39 01 00 00 00 00 02 5f 02 39 01 00 00 00 00 02 60 00 39 01 00 00 00 00 02 61 0c 39 01 00 00 00 00 02 62 0d 39 01 00 00 00 00 02 63 0e 39 01 00 00 00 00 02 64 0f 39 01 00 00 00 00 02 65 02 39 01 00 00 00 00 02 66 02 39 01 00 00 00 00 02 67 02 39 01 00 00 00 00 02 68 02 39 01 00 00 00 00 02 69 02 39 01 00 00 00 00 02 6a 02 39 01 00 00 00 00 02 6b 02 39 01 00 00 00 00 02 6c 02 39 01 00 00 00 00 02 6d 02 39 01 00 00 00 00 02 6e 05 39 01 00 00 00 00 02 6f 05 39 01 00 00 00 00 02 70 05 39 01 00 00 00 00 02 71 05 39 01 00 00 00 00 02 72 01 39 01 00 00 00 00 02 73 06 39 01 00 00 00 00 02 74 07 39 01 00 00 00 00 02 75 02 39 01 00 00 00 00 02 76 00 39 01 00 00 00 00 02 77 0c 39 01 00 00 00 00 02 78 0d 39 01 00 00 00 00 02 79 0e 39 01 00 00 00 00 02 7a 0f 39 01 00 00 00 00 02 7b 02 39 01 00 00 00 00 02 7c 02 39 01 00 00 00 00 02 7d 02 39 01 00 00 00 00 02 7e 02 39 01 00 00 00 00 02 7f 02 39 01 00 00 00 00 02 80 02 39 01 00 00 00 00 02 81 02 39 01 00 00 00 00 02 82 02 39 01 00 00 00 00 02 83 02 39 01 00 00 00 00 02 84 05 39 01 00 00 00 00 02 85 05 39 01 00 00 00 00 02 86 05 39 01 00 00 00 00 02 87 05 39 01 00 00 00 00 02 88 01 39 01 00 00 00 00 02 89 06 39 01 00 00 00 00 02 8a 07 39 01 00 00 00 00 04 ff 98 81 04 39 01 00 00 00 00 02 00 00 39 01 00 00 00 00 02 6c 15 39 01 00 00 00 00 02 6e 1a 39 01 00 00 00 00 02 6f 25 39 01 00 00 00 00 02 3a a4 39 01 00 00 00 00 02 8d 20 39 01 00 00 00 00 02 87 ba 39 01 00 00 00 00 02 26 76 39 01 00 00 00 00 02 b2 d1 39 01 00 00 00 00 02 17 0c 39 01 00 00 00 00 04 ff 98 81 01 39 01 00 00 00 00 02 22 0a 39 01 00 00 00 00 02 31 00 39 01 00 00 00 00 02 53 82 39 01 00 00 00 00 02 55 86 39 01 00 00 00 00 02 50 75 39 01 00 00 00 00 02 51 71 39 01 00 00 00 00 02 60 1b 39 01 00 00 00 00 02 61 01 39 01 00 00 00 00 02 62 0c 39 01 00 00 00 00 02 63 00 39 01 00 00 00 00 02 a0 00 39 01 00 00 00 00 02 a1 09 39 01 00 00 00 00 02 a2 11 39 01 00 00 00 00 02 a3 0c 39 01 00 00 00 00 02 a4 0e 39 01 00 00 00 00 02 a5 1f 39 01 00 00 00 00 02 a6 13 39 01 00 00 00 00 02 a7 18 39 01 00 00 00 00 02 a8 3e 39 01 00 00 00 00 02 a9 1c 39 01 00 00 00 00 02 aa 27 39 01 00 00 00 00 02 ab 37 39 01 00 00 00 00 02 ac 17 39 01 00 00 00 00 02 ad 14 39 01 00 00 00 00 02 ae 48 39 01 00 00 00 00 02 af 1d 39 01 00 00 00 00 02 b0 27 39 01 00 00 00 00 02 b1 4a 39 01 00 00 00 00 02 b2 61 39 01 00 00 00 00 02 b3 39 39 01 00 00 00 00 02 c0 00 39 01 00 00 00 00 02 c1 08 39 01 00 00 00 00 02 c2 11 39 01 00 00 00 00 02 c3 0d 39 01 00 00 00 00 02 c4 0d 39 01 00 00 00 00 02 c5 1e 39 01 00 00 00 00 02 c6 13 39 01 00 00 00 00 02 c7 19 39 01 00 00 00 00 02 c8 3e 39 01 00 00 00 00 02 c9 1b 39 01 00 00 00 00 02 ca 27 39 01 00 00 00 00 02 cb 38 39 01 00 00 00 00 02 cc 16 39 01 00 00 00 00 02 cd 14 39 01 00 00 00 00 02 ce 48 39 01 00 00 00 00 02 cf 1e 39 01 00 00 00 00 02 d0 27 39 01 00 00 00 00 02 d1 49 39 01 00 00 00 00 02 d2 61 39 01 00 00 00 00 02 d3 39 39 01 00 00 00 00 04 ff 98 81 00 39 01 00 00 00 00 02 35 00 39 01 00 00 78 00 02 11 00 39 01 00 00 0a 00 02 29 00];
				qcom,mdss-dsi-off-command = [05 01 00 00 1f 00 02 28 00 05 01 00 00 8c 00 02 10 00];
				qcom,mdss-dsi-on-command-state = "dsi_lp_mode";
				qcom,mdss-dsi-off-command-state = "dsi_hs_mode";
				qcom,mdss-dsi-h-sync-pulse = <0x01>;
				qcom,mdss-dsi-traffic-mode = "burst_mode";
				qcom,mdss-dsi-bllp-eof-power-mode;
				qcom,mdss-dsi-bllp-power-mode;
				qcom,mdss-dsi-lane-0-state;
				qcom,mdss-dsi-lane-1-state;
				qcom,mdss-dsi-lane-2-state;
				qcom,esd-check-enabled;
				//qcom,mdss-dsi-panel-status-command1 = [06 01 00 01 05 00 02 0a 08];
				//qcom,mdss-dsi-panel-status-command2 = [06 01 00 01 05 00 02 0b 08];
				qcom,mdss-dsi-panel-status-command = [06 01 00 01 05 00 02 0b 08];
				qcom,mdss-dsi-panel-status-command-state = "dsi_lp_mode";
				qcom,mdss-dsi-panel-status-check-mode = "reg_read";
				//qcom,mdss-dsi-panel-status-command-num = <0x02>;
				qcom,mdss-dsi-panel-status-value1 = <0x01 0x9c>;
				qcom,mdss-dsi-panel-status-value2 = <0x01 0x00>;
				qcom,mdss-dsi-panel-timings = <0xad281a00 0x52542090 0x21030400>;
				qcom,mdss-dsi-t-clk-post = <0x03>;
				qcom,mdss-dsi-t-clk-pre = <0x22>;
				qcom,mdss-dsi-bl-min-level = <0x01>;
				qcom,mdss-dsi-bl-max-level = <0xff>;
				qcom,mdss-dsi-bl-pmic-pwm-frequency = <0x28>;
				qcom,mdss-dsi-bl-pmic-bank-select = <0x00>;
				qcom,mdss-dsi-dma-trigger = "trigger_sw";
				qcom,mdss-dsi-mdp-trigger = "none";
				qcom,mdss-dsi-bl-pmic-control-type = "bl_ctrl_pwm";
				qcom,mdss-dsi-lp11-init;
				qcom,mdss-dsi-init-delay-us = <0xc350>;
				qcom,mdss-dsi-reset-sequence = <0x01 0x05 0x00 0x0a 0x01 0x50>;
			};
};